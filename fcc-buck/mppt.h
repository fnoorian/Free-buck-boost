//------------------------------------------------------------------------------------------------------
// MPPT Algorithm
//------------------------------------------------------------------------------------------------------
#define PWM_MPPT_MIN        0.5*PWM_FULL  // the min value for pwm duty cyle 0-100.0% in MPPT mode
#define PWM_MPPT_START      0.7*PWM_FULL  // the starting value for MPPT mode pwm duty cyle 0-100.0%

#define PWM_MPPT_INC        16            // the value the increment to the pwm value for the ppt algorithm
#define MIN_SOL_WATTS       100           // Minimum power from solar to keep MPPT on (1 Watt)
#define MIN_SOL_VOLTS       1200          // The minimum voltage of the solar panel to keep MPPT on (12 V)
#define MPPT_SKIP_COUNT     32            // number of iterations to skip updating MPPT state machine
#define MPPT_OFF_COUNT      32            // number of iterations of off charger state

//------------------------------------------------------------------------------------------------------
// MPPT Pwm adjust 
//------------------------------------------------------------------------------------------------------
void MPPT_PWM_Adjust(void) {
  
  static int old_in_watts = 0;
  static int delta =  PWM_MPPT_INC;         // variable used to modify pwm duty cycle for the ppt algorithm

  int in_watts = power_status.in_watts;

  if (old_in_watts >= in_watts) {           // if previous watts are greater change the value of
    delta = -delta;                         // delta to make pwm increase or decrease to maximize watts
  }
  
  int pwm = power_status.pwm_duty + delta;  // add delta to change PWM duty cycle for PPT algorithm 
  
  if (pwm < PWM_MPPT_MIN) {                 // Keep within MPPT min PWM duty cycle limit
    pwm = PWM_MPPT_MIN;
  }

  old_in_watts = in_watts;                // load old_watts with current watts value for next time
  set_pwm_duty(pwm);                        // set pwm duty cycle to pwm value
}

//------------------------------------------------------------------------------------------------------
// MPPT State Machine.
//
//  To adjust for the LPF, the machine will only switch states  
//
//  On State - this is charger state for solar watts > MIN_SOL_WATTS. This is where we run the 
//      Peak Power Tracking alogorithm. In this state we try and run the maximum amount
//      of current that the solar panels are generating into the other side.
//  Off State - This is state that the device enters when solar watts < MIN_SOL_WATTS. The device goes into this
//      state when it gets dark and there is no more power being generated by the solar panels. The MOSFETs are turned
//      off in this state so that power from the battery doesn't leak back into the solar panel. When the charger off
//      state is first entered all it does is decrement off_count for OFF_NUM times. This is done because if the battery
//      is disconnected (or battery fuse is blown) it takes some time before the battery voltage changes enough so we can tell
//      that the battery is no longer connected. This off_count gives some time for battery voltage to change so we can
//      tell this.
//------------------------------------------------------------------------------------------------------

void MPPT_state_machine(void) {

  static int off_count = MPPT_OFF_COUNT;       // Off counter

  int in_watts = power_status.in_watts;
  int sol_volts = power_status.in_volts;
  int bat_volts = power_status.out_volts;
  
  switch (power_status.mode) {
    case MODE_MPPT_ON:
      if (in_watts < MIN_SOL_WATTS) {         //if watts input from the solar panel is less than
        power_status.mode = MODE_MPPT_OFF;     //the minimum solar watts then it is getting dark so
        off_count = MPPT_OFF_COUNT;                   //go to the charger off state
        TURN_OFF_MOSFETS; 
      }
      else {                                   // this is where we do the Peak Power Tracking Maximum Power Point algorithm
        MPPT_PWM_Adjust();
      }
      break;
      
    case MODE_MPPT_OFF:                           //when we jump into the charger off state, off_count is set with OFF_NUM
      if (off_count > 0) {                        //this means that we run through the off state OFF_NUM of times with out doing
        off_count--;                              //anything, this is to allow the output voltage to settle down
      }                                           
      else if (sol_volts > MIN_SOL_VOLTS) {       // if we have solar volts more than MIN_SOL_VOLTS
        power_status.mode = MODE_MPPT_ON;         // start pumping the power
        set_pwm_duty(PWM_MPPT_START);                
        TURN_ON_MOSFETS; 
      }
      break;
    default:
      TURN_OFF_MOSFETS;                           // else stay in the off state
      break;
  }
}
